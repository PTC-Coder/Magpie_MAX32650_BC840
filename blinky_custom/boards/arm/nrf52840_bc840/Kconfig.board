## blinky_custom/boards/arm/nrf52840_bc840/Kconfig.board
```kconfig
# Copyright (c) 2024 Nordic Semiconductor ASA
# SPDX-License-Identifier: Apache-2.0

config BOARD_NRF52840_BC840
	bool "nrf52840_bc840"
	depends on SOC_NRF52840_QFAA
```

## blinky_custom/boards/arm/nrf52840_magpie/Kconfig.board
```kconfig
# Copyright (c) 2024 Nordic Semiconductor ASA
# SPDX-License-Identifier: Apache-2.0

config BOARD_NRF52840_MAGPIE
	bool "nrf52840_magpie"
	depends on SOC_NRF52840_QFAA
```

## littleFS/boards/arm/nrf52840_bc840/Kconfig.board
```kconfig
# Copyright (c) 2024 Nordic Semiconductor ASA
# SPDX-License-Identifier: Apache-2.0

config BOARD_NRF52840_BC840
	bool "BC840"
	depends on SOC_NRF52840_QFAA
```

## littleFS/boards/arm/nrf52840_bc840/Kconfig.defconfig
```kconfig
# Copyright (c) 2024 Nordic Semiconductor ASA
# SPDX-License-Identifier: Apache-2.0

if BOARD_NRF52840_BC840

config BOARD
	default "nrf52840_bc840"

config BT_CTLR
	default BT

endif # BOARD_NRF52840_BC840
```

## littleFS/boards/arm/nrf52840_magpie/Kconfig.defconfig
```kconfig
# Copyright (c) 2024 Nordic Semiconductor ASA
# SPDX-License-Identifier: Apache-2.0

if BOARD_NRF52840_MAGPIE

config BOARD
	default "nrf52840_magpie"

config BT_CTLR
	default BT

endif
```
